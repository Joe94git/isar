## meta-isar/conf/machine/agilex.conf
```bitbake
#
# Copyright (c) Intel Corporation, 2022#
# SPDX-License-Identifier: MIT

DISTRO_ARCH ?= "arm64"

KERNEL_NAME ?= "socfpga-lts"
```

## meta-isar/conf/machine/agilexrt.conf
```bitbake
#
# Copyright (c) Intel Corporation, 2022#
# SPDX-License-Identifier: MIT

DISTRO_ARCH ?= "arm64"

KERNEL_NAME ?= "socfpga-lts-rt"

PREFERRED_PROVIDER_u-boot-agilex = "u-boot-socfpga"
U_BOOT_CONFIG_agilex= "socfpga_agilex_defconfig"
U_BOOT_BIN_agilex = "u-boot.img"
IMAGE_FSTYPES ?= "tar.gz"
IMAGER_INSTALL += "u-boot-agilex"
IMAGER_BUILD_DEPS += "u-boot-agilex"

IMAGE_INSTALL += "u-boot-agilex libubootenv-tool u-boot-script"
```
